## drivers/misc/mediatek/video/Kconfig
```kconfig
config MTK_VIDEO
  bool CONFIG_MTK_VIDEO
  default n
  help
    CONFIG_MTK_VIDEO
    
config KLAPSE
  bool CONFIG_KLAPSE
  default n
  help
    A simple rgb dynamic lapsing module similar to livedisplay    
```
